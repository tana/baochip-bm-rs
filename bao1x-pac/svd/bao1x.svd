# bao1x register map
Vendor: baochip; File version: 1.0
Registers are 32-bit, read-write, reset 0x0 unless marked. A register's access mark holds for its fields unless they carry their own. Offsets are from the block's base; [hi:lo] are bit positions; {n}, {i} and the like mark numbered series; <NAME> marks a mode.

## GLUECHAIN
Base 0x40054000
0x00 SFR_GCMASK_CR_GCMASK0 — See `gluechain.sv#L44 <https://github.com/baochip/baochip-1x/blob/main/rtl/modul es/sec/rtl/gluechain.sv#L44>`__ (line numbers are approximate)
  [31:0] cr_gcmask0 — cr_gcmask read/write control register
0x04 SFR_GCSR_GLUEREG0 — See `gluechain.sv#L45 <https://github.com/baochip/baochip-1x/blob/main/rtl/modul es/sec/rtl/gluechain.sv#L45>`__ (line numbers are approximate)
  [31:0] gluereg0 — gluereg read only status register
0x08 SFR_GCRST_GLUERST0 — See `gluechain.sv#L46 <https://github.com/baochip/baochip-1x/blob/main/rtl/modul es/sec/rtl/gluechain.sv#L46>`__ (line numbers are approximate)
  [31:0] gluerst0 — gluerst read/write control register
0x0C SFR_GCTEST_GLUETEST0 — See `gluechain.sv#L47 <https://github.com/baochip/baochip-1x/blob/main/rtl/modul es/sec/rtl/gluechain.sv#L47>`__ (line numbers are approximate)
  [31:0] gluetest0 — gluetest read/write control register

## MESH
Base 0x40052000
0x00 SFR_MLDRV_CR_MLDRV0 — See `mesh.sv#L49 <https://github.com/baochip/baochip-1x/blob/main/rtl/modules/se c/rtl/mesh.sv#L49>`__ (line numbers are approximate)
  [31:0] cr_mldrv0 — cr_mldrv read/write control register
0x04 SFR_MLDRV_CR_MLDRV1 — See `mesh.sv#L49 <https://github.com/baochip/baochip-1x/blob/main/rtl/modules/se c/rtl/mesh.sv#L49>`__ (line numbers are approximate)
  [31:0] cr_mldrv1 — cr_mldrv read/write control register
0x10 SFR_MLIE_CR_MLIE0 — See `mesh.sv#L50 <https://github.com/baochip/baochip-1x/blob/main/rtl/modules/se c/rtl/mesh.sv#L50>`__ (line numbers are approximate)
  [31:0] cr_mlie0 — cr_mlie read/write control register
0x14 SFR_MLIE_CR_MLIE1 — See `mesh.sv#L50 <https://github.com/baochip/baochip-1x/blob/main/rtl/modules/se c/rtl/mesh.sv#L50>`__ (line numbers are approximate)
  [31:0] cr_mlie1 — cr_mlie read/write control register
{0x20+4i} SFR_MLSR_SR_MLSR{i} (i=0..7) — See `mesh.sv#L51 <https://github.com/baochip/baochip-1x/blob/main/rtl/modules/se c/rtl/mesh.sv#L51>`__ (line numbers are approximate)
  [31:0] sr_mlsr{i} — sr_mlsr read only status register

## SENSORC
Base 0x40053000
0x00 SFR_VDMASK0 — See `sensorc.sv#L63 <https://github.com/baochip/baochip-1x/blob/main/rtl/modules /sec/rtl/sensorc.sv#L63>`__ (line numbers are approximate)
  [7:0] cr_vdmask0 — cr_vdmask0 read/write control register
0x04 SFR_VDMASK1 — See `sensorc.sv#L64 <https://github.com/baochip/baochip-1x/blob/main/rtl/modules /sec/rtl/sensorc.sv#L64>`__ (line numbers are approximate)
  [7:0] cr_vdmask1 — cr_vdmask1 read/write control register
0x08 SFR_VDSR — See `sensorc.sv#L65 <https://github.com/baochip/baochip-1x/blob/main/rtl/modules /sec/rtl/sensorc.sv#L65>`__ (line numbers are approximate)
  [7:0] vdflag — vdflag read only status register
0x0C SFR_VDFR — See `sensorc.sv#L66 <https://github.com/baochip/baochip-1x/blob/main/rtl/modules /sec/rtl/sensorc.sv#L66>`__ (line numbers are approximate)
  [7:0] vdflag — vdflag flag register. `1` means event happened, write back `1` in respective bit position to clear the flag
0x10 SFR_LDMASK — See `sensorc.sv#L68 <https://github.com/baochip/baochip-1x/blob/main/rtl/modules /sec/rtl/sensorc.sv#L68>`__ (line numbers are approximate)
  [3:0] cr_ldmask — cr_ldmask read/write control register
0x14 SFR_LDSR — See `sensorc.sv#L69 <https://github.com/baochip/baochip-1x/blob/main/rtl/modules /sec/rtl/sensorc.sv#L69>`__ (line numbers are approximate)
  [3:0] sr_ldsr — sr_ldsr read only status register
0x18 SFR_LDCFG — See `sensorc.sv#L70 <https://github.com/baochip/baochip-1x/blob/main/rtl/modules /sec/rtl/sensorc.sv#L70>`__ (line numbers are approximate)
  [3:0] sfr_ldcfg — sfr_ldcfg read/write control register
{0x20+4i} SFR_VDCFG_CR_VDCFG{i} (i=0..7) — See `sensorc.sv#L72 <https://github.com/baochip/baochip-1x/blob/main/rtl/modules /sec/rtl/sensorc.sv#L72>`__ (line numbers are approximate)
  [3:0] cr_vdcfg{i} — cr_vdcfg read/write control register
0x40 SFR_VDIP_ENA — See `sensorc.sv#L74 <https://github.com/baochip/baochip-1x/blob/main/rtl/modules /sec/rtl/sensorc.sv#L74>`__ (line numbers are approximate)
  [5:0] vdena — vdena read/write control register
0x44 SFR_VDIP_TEST — See `sensorc.sv#L75 <https://github.com/baochip/baochip-1x/blob/main/rtl/modules /sec/rtl/sensorc.sv#L75>`__ (line numbers are approximate)
  [7:0] vdtst — vdtst read/write control register
0x48 SFR_LDIP_TEST — See `sensorc.sv#L77 <https://github.com/baochip/baochip-1x/blob/main/rtl/modules /sec/rtl/sensorc.sv#L77>`__ (line numbers are approximate)
  [3:0] ldtst — ldtst read/write control register
0x4C SFR_LDIP_FD — See `sensorc.sv#L78 <https://github.com/baochip/baochip-1x/blob/main/rtl/modules /sec/rtl/sensorc.sv#L78>`__ (line numbers are approximate)
  [15:0] sfr_ldip_fd — sfr_ldip_fd read/write control register
