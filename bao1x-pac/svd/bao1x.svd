# bao1x register map
Vendor: baochip; File version: 1.0
Registers are 32-bit, read-write, reset 0x0 unless marked. A register's access mark holds for its fields unless they carry their own. Offsets are from the block's base; [hi:lo] are bit positions; <NAME> marks a mode.

## SCEDMA
Base 0x40029000
0x00 SFR_SCHSTART_AR — See `scedma.sv#L95 <https://github.com/baochip/baochip-1x/blob/main/rtl/modules/ crypto_top/rtl/scedma.sv#L95>`__ (line numbers are approximate)
  [31:0] sfr_schstart_ar — sfr_schstart_ar performs action on write of value: 0xaa
0x10 SFR_XCH_FUNC — See `scedma.sv#L97 <https://github.com/baochip/baochip-1x/blob/main/rtl/modules/ crypto_top/rtl/scedma.sv#L97>`__ (line numbers are approximate)
  [0] xchcr_func — xchcr_func read/write control register
0x14 SFR_XCH_OPT — See `scedma.sv#L98 <https://github.com/baochip/baochip-1x/blob/main/rtl/modules/ crypto_top/rtl/scedma.sv#L98>`__ (line numbers are approximate)
  [9:0] xchcr_opt — xchcr_opt read/write control register
0x18 SFR_XCH_AXSTART — See `scedma.sv#L99 <https://github.com/baochip/baochip-1x/blob/main/rtl/modules/ crypto_top/rtl/scedma.sv#L99>`__ (line numbers are approximate)
  [31:0] xchcr_axstart — xchcr_axstart read/write control register
0x1C SFR_XCH_SEGID — See `scedma.sv#L100 <https://github.com/baochip/baochip-1x/blob/main/rtl/modules /crypto_top/rtl/scedma.sv#L100>`__ (line numbers are approximate)
  [7:0] xchcr_segid — xchcr_segid read/write control register
0x20 SFR_XCH_SEGSTART — See `scedma.sv#L101 <https://github.com/baochip/baochip-1x/blob/main/rtl/modules /crypto_top/rtl/scedma.sv#L101>`__ (line numbers are approximate)
  [11:0] xchcr_segstart — xchcr_segstart read/write control register
0x24 SFR_XCH_TRANSIZE — See `scedma.sv#L102 <https://github.com/baochip/baochip-1x/blob/main/rtl/modules /crypto_top/rtl/scedma.sv#L102>`__ (line numbers are approximate)
  [29:0] xchcr_transize — xchcr_transize read/write control register
0x30 SFR_SCH_FUNC — See `scedma.sv#L104 <https://github.com/baochip/baochip-1x/blob/main/rtl/modules /crypto_top/rtl/scedma.sv#L104>`__ (line numbers are approximate)
  [0] schcr_func — schcr_func read/write control register
0x34 SFR_SCH_OPT — See `scedma.sv#L105 <https://github.com/baochip/baochip-1x/blob/main/rtl/modules /crypto_top/rtl/scedma.sv#L105>`__ (line numbers are approximate)
  [9:0] schcr_opt — schcr_opt read/write control register
0x38 SFR_SCH_AXSTART — See `scedma.sv#L106 <https://github.com/baochip/baochip-1x/blob/main/rtl/modules /crypto_top/rtl/scedma.sv#L106>`__ (line numbers are approximate)
  [31:0] schcr_axstart — schcr_axstart read/write control register
0x3C SFR_SCH_SEGID — See `scedma.sv#L107 <https://github.com/baochip/baochip-1x/blob/main/rtl/modules /crypto_top/rtl/scedma.sv#L107>`__ (line numbers are approximate)
  [7:0] schcr_segid — schcr_segid read/write control register
0x40 SFR_SCH_SEGSTART — See `scedma.sv#L108 <https://github.com/baochip/baochip-1x/blob/main/rtl/modules /crypto_top/rtl/scedma.sv#L108>`__ (line numbers are approximate)
  [11:0] schcr_segstart — schcr_segstart read/write control register
0x44 SFR_SCH_TRANSIZE — See `scedma.sv#L109 <https://github.com/baochip/baochip-1x/blob/main/rtl/modules /crypto_top/rtl/scedma.sv#L109>`__ (line numbers are approximate)
  [29:0] schcr_transize — schcr_transize read/write control register
0x50 SFR_ICH_OPT — See `scedma.sv#L111 <https://github.com/baochip/baochip-1x/blob/main/rtl/modules /crypto_top/rtl/scedma.sv#L111>`__ (line numbers are approximate)
  [3:0] sfr_ich_opt — sfr_ich_opt read/write control register
0x54 SFR_ICH_SEGID — See `scedma.sv#L112 <https://github.com/baochip/baochip-1x/blob/main/rtl/modules /crypto_top/rtl/scedma.sv#L112>`__ (line numbers are approximate)
  [15:0] sfr_ich_segid — sfr_ich_segid read/write control register
0x58 SFR_ICH_RPSTART — See `scedma.sv#L113 <https://github.com/baochip/baochip-1x/blob/main/rtl/modules /crypto_top/rtl/scedma.sv#L113>`__ (line numbers are approximate)
  [11:0] ichcr_rpstart — ichcr_rpstart read/write control register
0x5C SFR_ICH_WPSTART — See `scedma.sv#L114 <https://github.com/baochip/baochip-1x/blob/main/rtl/modules /crypto_top/rtl/scedma.sv#L114>`__ (line numbers are approximate)
  [11:0] ichcr_wpstart — ichcr_wpstart read/write control register
0x60 SFR_ICH_TRANSIZE — See `scedma.sv#L115 <https://github.com/baochip/baochip-1x/blob/main/rtl/modules /crypto_top/rtl/scedma.sv#L115>`__ (line numbers are approximate)
  [11:0] ichcr_transize — ichcr_transize read/write control register
0x70 SFR_WDATABYPASS_MODE — See `scedma.sv#L117 <https://github.com/baochip/baochip-1x/blob/main/rtl/modules /crypto_top/rtl/scedma.sv#L117>`__ (line numbers are approximate)
  [1:0] sfr_wdatabypass_mode — sfr_wdatabypass_mode read/write control register
0x74 SFR_WDATABYPASS_DATA — See `scedma.sv#L118 <https://github.com/baochip/baochip-1x/blob/main/rtl/modules /crypto_top/rtl/scedma.sv#L118>`__ (line numbers are approximate)
  [31:0] sfr_wdatabypass_data — sfr_wdatabypass_data read/write control register
