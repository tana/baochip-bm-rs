# bao1x register map
Vendor: baochip; File version: 1.0
Registers are 32-bit, read-write, reset 0x0 unless marked. A register's access mark holds for its fields unless they carry their own. Offsets are from the block's base; [hi:lo] are bit positions; {n}, {i} and the like mark numbered series; <NAME> marks a mode.

## SYSCTRL
Base 0x40040000
0x00 SFR_CGUSEC — See `sysctrl.sv#L768 <https://github.com/baochip/baochip-1x/blob/main/rtl/module s/sysctrl/rtl/sysctrl.sv#L768>`__ (line numbers are approximate)
  [15:0] sfr_cgusec — sfr_cgusec read/write control register
0x04 SFR_CGULP — See `sysctrl.sv#L769 <https://github.com/baochip/baochip-1x/blob/main/rtl/module s/sysctrl/rtl/sysctrl.sv#L769>`__ (line numbers are approximate)
  [15:0] sfr_cgulp — sfr_cgulp read/write control register
0x08 SFR_SEED — See `sysctrl.sv#L771 <https://github.com/baochip/baochip-1x/blob/main/rtl/module s/sysctrl/rtl/sysctrl.sv#L771>`__ (line numbers are approximate)
  [31:0] sfr_seed — sfr_seed read/write control register
0x0C SFR_SEEDAR — See `sysctrl.sv#L772 <https://github.com/baochip/baochip-1x/blob/main/rtl/module s/sysctrl/rtl/sysctrl.sv#L772>`__ (line numbers are approximate)
  [31:0] sfr_seedar — sfr_seedar performs action on write of value: 0x5a
0x10 SFR_CGUSEL0 — See `sysctrl.sv#L774 <https://github.com/baochip/baochip-1x/blob/main/rtl/module s/sysctrl/rtl/sysctrl.sv#L774>`__ (line numbers are approximate)
  [1:0] sfr_cgusel0 — sfr_cgusel0 read/write control register
{0x14+4i} SFR_CGUFD_CFGFDCR_0_4_{i} (i=0..4) — See `sysctrl.sv#L775 <https://github.com/baochip/baochip-1x/blob/main/rtl/module s/sysctrl/rtl/sysctrl.sv#L775>`__ (line numbers are approximate)
  [31:0] cfgfdcr_0_4_{i} — cfgfdcr read/write control register
0x28 SFR_CGUFDAO — See `sysctrl.sv#L778 <https://github.com/baochip/baochip-1x/blob/main/rtl/module s/sysctrl/rtl/sysctrl.sv#L778>`__ (line numbers are approximate)
  [31:0] cfgfdcr — cfgfdcr read/write control register
0x2C SFR_CGUSET — See `sysctrl.sv#L781 <https://github.com/baochip/baochip-1x/blob/main/rtl/module s/sysctrl/rtl/sysctrl.sv#L781>`__ (line numbers are approximate)
  [31:0] sfr_cguset — sfr_cguset performs action on write of value: 0x32
0x30 SFR_CGUSEL1 — See `sysctrl.sv#L782 <https://github.com/baochip/baochip-1x/blob/main/rtl/module s/sysctrl/rtl/sysctrl.sv#L782>`__ (line numbers are approximate)
  [0] sfr_cgusel1 — sfr_cgusel1 read/write control register
0x34 SFR_CGUFDPKE — See `sysctrl.sv#L777 <https://github.com/baochip/baochip-1x/blob/main/rtl/module s/sysctrl/rtl/sysctrl.sv#L777>`__ (line numbers are approximate)
  [7:0] sfr_cgufdpke — sfr_cgufdpke read/write control register
0x38 SFR_CGUFDAORAM — See `sysctrl.sv#L779 <https://github.com/baochip/baochip-1x/blob/main/rtl/module s/sysctrl/rtl/sysctrl.sv#L779>`__ (line numbers are approximate)
  [15:0] sfr_cgufdaoram — sfr_cgufdaoram read/write control register
0x3C SFR_CGUFDPER — See `sysctrl.sv#L776 <https://github.com/baochip/baochip-1x/blob/main/rtl/module s/sysctrl/rtl/sysctrl.sv#L776>`__ (line numbers are approximate)
  [31:0] sfr_cgufdper — sfr_cgufdper read/write control register
{0x40+4i} SFR_CGUFSSR_FSFREQ{i} (i=0..3) — See `sysctrl.sv#L785 <https://github.com/baochip/baochip-1x/blob/main/rtl/module s/sysctrl/rtl/sysctrl.sv#L785>`__ (line numbers are approximate)
  [31:0] fsfreq{i} — fsfreq read only status register
0x50 SFR_CGUFSVLD — See `sysctrl.sv#L786 <https://github.com/baochip/baochip-1x/blob/main/rtl/module s/sysctrl/rtl/sysctrl.sv#L786>`__ (line numbers are approximate)
  [7:0] sfr_cgufsvld — sfr_cgufsvld read only status register
0x54 SFR_CGUFSCR — See `sysctrl.sv#L787 <https://github.com/baochip/baochip-1x/blob/main/rtl/module s/sysctrl/rtl/sysctrl.sv#L787>`__ (line numbers are approximate)
  [15:0] sfr_cgufscr — sfr_cgufscr read/write control register
0x60 SFR_ACLKGR — See `sysctrl.sv#L794 <https://github.com/baochip/baochip-1x/blob/main/rtl/module s/sysctrl/rtl/sysctrl.sv#L794>`__ (line numbers are approximate)
  [7:0] aclksubgate — aclksubgate read only status register
0x64 SFR_HCLKGR — See `sysctrl.sv#L795 <https://github.com/baochip/baochip-1x/blob/main/rtl/module s/sysctrl/rtl/sysctrl.sv#L795>`__ (line numbers are approximate)
  [7:0] hclksubgate — hclksubgate read only status register
0x68 SFR_ICLKGR — See `sysctrl.sv#L796 <https://github.com/baochip/baochip-1x/blob/main/rtl/module s/sysctrl/rtl/sysctrl.sv#L796>`__ (line numbers are approximate)
  [7:0] iclksubgate — iclksubgate read only status register
0x6C SFR_PCLKGR — See `sysctrl.sv#L797 <https://github.com/baochip/baochip-1x/blob/main/rtl/module s/sysctrl/rtl/sysctrl.sv#L797>`__ (line numbers are approximate)
  [7:0] pclksubgate — pclksubgate read only status register
0x80 SFR_RCURST0 — See `sysctrl.sv#L804 <https://github.com/baochip/baochip-1x/blob/main/rtl/module s/sysctrl/rtl/sysctrl.sv#L804>`__ (line numbers are approximate)
  [31:0] sfr_rcurst0 — sfr_rcurst0 performs action on write of value: 0x55aa
0x84 SFR_RCURST1 — See `sysctrl.sv#L805 <https://github.com/baochip/baochip-1x/blob/main/rtl/module s/sysctrl/rtl/sysctrl.sv#L805>`__ (line numbers are approximate)
  [31:0] sfr_rcurst1 — sfr_rcurst1 performs action on write of value: 0x55aa
0x88 SFR_RCUSRCFR — See `sysctrl.sv#L806 <https://github.com/baochip/baochip-1x/blob/main/rtl/module s/sysctrl/rtl/sysctrl.sv#L806>`__ (line numbers are approximate)
  [15:0] sfr_rcusrcfr — sfr_rcusrcfr flag register. `1` means event happened, write back `1` in respective bit position to clear the flag
0x90 SFR_IPCARIPFLOW — See `sysctrl.sv#L810 <https://github.com/baochip/baochip-1x/blob/main/rtl/module s/sysctrl/rtl/sysctrl.sv#L810>`__ (line numbers are approximate)
  [31:0] sfr_ipcaripflow — sfr_ipcaripflow performs action on write of value: 0x57
0x94 SFR_IPCEN — See `sysctrl.sv#L811 <https://github.com/baochip/baochip-1x/blob/main/rtl/module s/sysctrl/rtl/sysctrl.sv#L811>`__ (line numbers are approximate)
  [15:0] sfr_ipcen — sfr_ipcen read/write control register
0x98 SFR_IPCLPEN — See `sysctrl.sv#L812 <https://github.com/baochip/baochip-1x/blob/main/rtl/module s/sysctrl/rtl/sysctrl.sv#L812>`__ (line numbers are approximate)
  [15:0] sfr_ipclpen — sfr_ipclpen read/write control register
0x9C SFR_IPCOSC — See `sysctrl.sv#L813 <https://github.com/baochip/baochip-1x/blob/main/rtl/module s/sysctrl/rtl/sysctrl.sv#L813>`__ (line numbers are approximate)
  [6:0] sfr_ipcosc — sfr_ipcosc read/write control register
0xA0 SFR_IPCPLLMN — See `sysctrl.sv#L814 <https://github.com/baochip/baochip-1x/blob/main/rtl/module s/sysctrl/rtl/sysctrl.sv#L814>`__ (line numbers are approximate)
  [16:0] sfr_ipcpllmn — sfr_ipcpllmn read/write control register
0xA4 SFR_IPCPLLF — See `sysctrl.sv#L815 <https://github.com/baochip/baochip-1x/blob/main/rtl/module s/sysctrl/rtl/sysctrl.sv#L815>`__ (line numbers are approximate)
  [24:0] sfr_ipcpllf — sfr_ipcpllf read/write control register
0xA8 SFR_IPCPLLQ — See `sysctrl.sv#L816 <https://github.com/baochip/baochip-1x/blob/main/rtl/module s/sysctrl/rtl/sysctrl.sv#L816>`__ (line numbers are approximate)
  [14:0] sfr_ipcpllq — sfr_ipcpllq read/write control register
0xAC SFR_IPCCR — See `sysctrl.sv#L817 <https://github.com/baochip/baochip-1x/blob/main/rtl/module s/sysctrl/rtl/sysctrl.sv#L817>`__ (line numbers are approximate)
  [15:0] sfr_ipccr — sfr_ipccr read/write control register
