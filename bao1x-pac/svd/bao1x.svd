# bao1x register map
Vendor: baochip; File version: 1.0
Registers are 32-bit, read-write, reset 0x0 unless marked. A register's access mark holds for its fields unless they carry their own. Offsets are from the block's base; [hi:lo] are bit positions; {n}, {i} and the like mark numbered series; <NAME> marks a mode.

## TRNG
Base 0x4002E000
0x00 SFR_CRSRC — See `trng.sv#L105 <https://github.com/baochip/baochip-1x/blob/main/rtl/modules/c rypto_top/rtl/trng.sv#L105>`__ (line numbers are approximate)
  [12:0] sfr_crsrc — sfr_crsrc read/write control register
0x04 SFR_CRANA — See `trng.sv#L106 <https://github.com/baochip/baochip-1x/blob/main/rtl/modules/c rypto_top/rtl/trng.sv#L106>`__ (line numbers are approximate)
  [15:0] sfr_crana — sfr_crana read/write control register
0x08 SFR_PP — See `trng.sv#L107 <https://github.com/baochip/baochip-1x/blob/main/rtl/modules/c rypto_top/rtl/trng.sv#L107>`__ (line numbers are approximate)
  [16:0] sfr_pp — sfr_pp read/write control register
0x0C SFR_OPT — See `trng.sv#L108 <https://github.com/baochip/baochip-1x/blob/main/rtl/modules/c rypto_top/rtl/trng.sv#L108>`__ (line numbers are approximate)
  [16:0] sfr_opt — sfr_opt read/write control register
0x10 SFR_SR — See `trng.sv#L114 <https://github.com/baochip/baochip-1x/blob/main/rtl/modules/c rypto_top/rtl/trng.sv#L114>`__ (line numbers are approximate)
  [31:0] sr_rng — sr_rng read only status register
0x14 SFR_AR_GEN — See `trng.sv#L112 <https://github.com/baochip/baochip-1x/blob/main/rtl/modules/c rypto_top/rtl/trng.sv#L112>`__ (line numbers are approximate)
  [31:0] sfr_ar_gen — sfr_ar_gen performs action on write of value: 0x55
0x18 SFR_FR — See `trng.sv#L115 <https://github.com/baochip/baochip-1x/blob/main/rtl/modules/c rypto_top/rtl/trng.sv#L115>`__ (line numbers are approximate)
  [2:0] sfr_fr — sfr_fr flag register. `1` means event happened, write back `1` in respective bit position to clear the flag
0x20 SFR_DRPSZ — See `trng.sv#L239 <https://github.com/baochip/baochip-1x/blob/main/rtl/modules/c rypto_top/rtl/trng.sv#L239>`__ (line numbers are approximate)
  [31:0] sfr_drpsz — sfr_drpsz read/write control register
0x24 SFR_DRGEN — See `trng.sv#L240 <https://github.com/baochip/baochip-1x/blob/main/rtl/modules/c rypto_top/rtl/trng.sv#L240>`__ (line numbers are approximate)
  [31:0] sfr_drgen — sfr_drgen read/write control register
0x28 SFR_DRRESEED — See `trng.sv#L241 <https://github.com/baochip/baochip-1x/blob/main/rtl/modules/c rypto_top/rtl/trng.sv#L241>`__ (line numbers are approximate)
  [31:0] sfr_drreseed — sfr_drreseed read/write control register
0x30 SFR_BUF — See `trng.sv#L242 <https://github.com/baochip/baochip-1x/blob/main/rtl/modules/c rypto_top/rtl/trng.sv#L242>`__ (line numbers are approximate)
  [31:0] sfr_buf — sfr_buf read only status register
{0x40+4i} SFR_CHAIN_RNGCHAINEN{i} (i=0..3) — See `trng.sv#L117 <https://github.com/baochip/baochip-1x/blob/main/rtl/modules/c rypto_top/rtl/trng.sv#L117>`__ (line numbers are approximate)
  [31:0] rngchainen{i} — rngchainen read/write control register

## SCE_GLBSFR
Base 0x40028000
0x04 SFR_SUBEN — See `sce_glbsfra.sv#L76 <https://github.com/baochip/baochip-1x/blob/main/rtl/mod ules/crypto_top/rtl/sce_glbsfra.sv#L76>`__ (line numbers are approximate)
  [15:0] cr_suben — cr_suben read/write control register
0x08 SFR_APBS — See `sce_glbsfra.sv#L77 <https://github.com/baochip/baochip-1x/blob/main/rtl/mod ules/crypto_top/rtl/sce_glbsfra.sv#L77>`__ (line numbers are approximate)
  [4:0] cr_apbsopt — cr_apbsopt read/write control register
0x10 SFR_SRBUSY — See `sce_glbsfra.sv#L79 <https://github.com/baochip/baochip-1x/blob/main/rtl/mod ules/crypto_top/rtl/sce_glbsfra.sv#L79>`__ (line numbers are approximate)
  [15:0] sr_busy — sr_busy read only status register
0x14 SFR_FRDONE — See `sce_glbsfra.sv#L80 <https://github.com/baochip/baochip-1x/blob/main/rtl/mod ules/crypto_top/rtl/sce_glbsfra.sv#L80>`__ (line numbers are approximate)
  [15:0] fr_done — fr_done flag register. `1` means event happened, write back `1` in respective bit position to clear the flag
0x18 SFR_FRERR — See `sce_glbsfra.sv#L81 <https://github.com/baochip/baochip-1x/blob/main/rtl/mod ules/crypto_top/rtl/sce_glbsfra.sv#L81>`__ (line numbers are approximate)
  [15:0] fr_err — fr_err flag register. `1` means event happened, write back `1` in respective bit position to clear the flag
0x1C SFR_ARCLR — See `sce_glbsfra.sv#L84 <https://github.com/baochip/baochip-1x/blob/main/rtl/mod ules/crypto_top/rtl/sce_glbsfra.sv#L84>`__ (line numbers are approximate)
  [31:0] ar_clrram — ar_clrram performs action on write of value: 0xa5
0x20 SFR_TICKCYC — See `sce_glbsfra.sv#L116 <https://github.com/baochip/baochip-1x/blob/main/rtl/mo dules/crypto_top/rtl/sce_glbsfra.sv#L116>`__ (line numbers are approximate)
  [7:0] sfr_tickcyc — sfr_tickcyc read/write control register
0x24 SFR_TICKCNT — See `sce_glbsfra.sv#L117 <https://github.com/baochip/baochip-1x/blob/main/rtl/mo dules/crypto_top/rtl/sce_glbsfra.sv#L117>`__ (line numbers are approximate)
  [31:0] sfr_tickcnt — sfr_tickcnt read only status register
0x30 SFR_FFEN — See `sce_glbsfra.sv#L90 <https://github.com/baochip/baochip-1x/blob/main/rtl/mod ules/crypto_top/rtl/sce_glbsfra.sv#L90>`__ (line numbers are approximate)
  [5:0] cr_ffen — cr_ffen read/write control register
0x34 SFR_FFCLR — See `sce_glbsfra.sv#L96 <https://github.com/baochip/baochip-1x/blob/main/rtl/mod ules/crypto_top/rtl/sce_glbsfra.sv#L96>`__ (line numbers are approximate)
  [31:0] ar_ffclr — ar_ffclr performs action on write of value: (32'hff00+i)
{0x40+4i} SFR_FFCNT_SR_FF{i} (i=0..5) — See `sce_glbsfra.sv#L91 <https://github.com/baochip/baochip-1x/blob/main/rtl/mod ules/crypto_top/rtl/sce_glbsfra.sv#L91>`__ (line numbers are approximate)
  [15:0] sr_ff{i} — sr_ff read only status register
0x60 SFR_FRACERR — See `sce_glbsfra.sv#L86 <https://github.com/baochip/baochip-1x/blob/main/rtl/mod ules/crypto_top/rtl/sce_glbsfra.sv#L86>`__ (line numbers are approximate)
  [7:0] fr_acerr — fr_acerr flag register. `1` means event happened, write back `1` in respective bit position to clear the flag
{0xE0+4i} SFR_TS_SR_TS{i} (i=0..3) — See `sce_glbsfra.sv#L100 <https://github.com/baochip/baochip-1x/blob/main/rtl/mo dules/crypto_top/rtl/sce_glbsfra.sv#L100>`__ (line numbers are approximate)
  [31:0] sr_ts{i} — sr_ts read only status register
