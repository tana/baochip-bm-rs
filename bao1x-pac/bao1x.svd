# bao1x register map
Vendor: baochip
Baochip-1x SoC
Registers are 32-bit, read-write, reset 0x0 unless marked. A register's access mark holds for its fields unless they carry their own. Offsets are from the block's base; lines under a group give offsets from that group; [hi:lo] are bit positions; {n}, {i} and the like mark numbered series; 'fields as' and 'values as' point back to an identical list; <NAME> marks a mode.

## Memory map
0x40000000 RRC size 0xF4
0x40010000 QFC size 0x54
0x40011000 PL230 blocks up to offset 0x50 — PL230 DMA Controller Core
0x40011000 PL230 blocks up to offset 0x50 — PL230 DMA Controller Core
0x40012000 MDMA size 0x60
0x40013000 MBOX_APB size 0x20
0x40014000 CORESUB_SRAMTRM size 0x34
0x40028000 SCE_GLBSFR size 0xF0
0x40029000 SCEDMA size 0x78
0x4002B000 COMBOHASH size 0x64
0x4002C000 PKE size 0x68
0x4002D000 AES size 0x40
0x4002E000 TRNG size 0x50
0x4002F000 ALU size 0x40
0x40040000 SYSCTRL size 0xB0
0x40041000 WDG_INTF size 0x4
0x40042000 DUART size 0x10
0x40043000 TIMER_INTF size 0x4
0x40044000 EVC size 0xA4
0x40045000 RBIST_WRP size 0xC
0x40052000 MESH size 0x40
0x40053000 SENSORC size 0x50
0x40054000 GLUECHAIN size 0x10
0x40060000 AO_SYSCTRL size 0x68
0x40064000 DKPC size 0x34
0x40065000 AOBUREG size 0x20
0x50100000 UDMA_CTRL size 0xC
0x50101000 UDMA_UART_0 size 0x38
0x50102000 UDMA_UART_1 size 0x38
0x50103000 UDMA_UART_2 size 0x38
0x50104000 UDMA_UART_3 size 0x38
0x50105000 UDMA_SPIM_0 size 0x34
0x50106000 UDMA_SPIM_1 size 0x34
0x50107000 UDMA_SPIM_2 size 0x34
0x50108000 UDMA_SPIM_3 size 0x34
0x50109000 UDMA_I2C_0 size 0x3C
0x5010A000 UDMA_I2C_1 size 0x3C
0x5010B000 UDMA_I2C_2 size 0x3C
0x5010C000 UDMA_I2C_3 size 0x3C
0x5010D000 UDMA_SDIO size 0x4C
0x5010E000 UDMA_I2S size 0x30
0x5010F000 UDMA_CAMERA size 0x38
0x50110000 UDMA_FILTER size 0x64
0x50111000 UDMA_SCIF size 0x3C
0x50112000 UDMA_SPIS_0 size 0x38
0x50113000 UDMA_SPIS_1 size 0x38
0x50114000 UDMA_ADC size 0x14
0x50120000 PWM size 0x150
0x50121000 SDDC size 0x1F4
0x50122000 APB_THRU size 0x4
0x50124000 BIO_BDMA size 0x100
0x50129000 BIO_FIFO0 size 0x44
0x5012A000 BIO_FIFO1 size 0x44
0x5012B000 BIO_FIFO2 size 0x44
0x5012C000 BIO_FIFO3 size 0x44
0x5012F000 IOX size 0x278

## Further device data
memoryRegions:
  SCE baseAddress=0x40028000 size=0x00008000
  SYSCTRL baseAddress=0x40040000 size=0x00010000
  IFSUB baseAddress=0x50120000 size=0x00003000
  CORESUB baseAddress=0x40010000 size=0x00010000
  RRC baseAddress=0x40000000 size=0x00010000
  SECSUB baseAddress=0x40050000 size=0x00010000
  BIO_BDMA baseAddress=0x50124000 size=0x00001000
  AO baseAddress=0x40060000 size=0x00010000
  AOPERI baseAddress=0x40061000 size=0x00005000
  SEG_LKEY baseAddress=0x40020000 size=0x00000100
  SEG_KEY baseAddress=0x40020100 size=0x00000100
  SEG_SKEY baseAddress=0x40020200 size=0x00000100
  SEG_SCRT baseAddress=0x40020300 size=0x00000100
  SEG_MSG baseAddress=0x40020400 size=0x00000200
  SEG_HOUT baseAddress=0x40020600 size=0x00000100
  SEG_SOB baseAddress=0x40020700 size=0x00000100
  SEG_PCON baseAddress=0x40020800 size=0x00000000
  SEG_PKB baseAddress=0x40020800 size=0x00000400
  SEG_PIB baseAddress=0x40020C00 size=0x00000800
  SEG_PSIB baseAddress=0x40021400 size=0x00000000
  SEG_POB baseAddress=0x40021400 size=0x00000400
  SEG_PSOB baseAddress=0x40021800 size=0x00000400
  SEG_AKEY baseAddress=0x40021C00 size=0x00000100
  SEG_AIB baseAddress=0x40021D00 size=0x00000100
  SEG_AOB baseAddress=0x40021E00 size=0x00000100
  SEG_RNGA baseAddress=0x40021F00 size=0x00000400
  SEG_RNGB baseAddress=0x40022300 size=0x00000400
  IFRAM0 baseAddress=0x50000000 size=0x00020000
  IFRAM1 baseAddress=0x50020000 size=0x00020000
  NULL baseAddress=0x50040000 size=0x00010000
  UDMA baseAddress=0x50100000 size=0x00020000
  UDP baseAddress=0x50122000 size=0x00001000
  SDDC_DAT baseAddress=0x50140000 size=0x00010000
  UDC baseAddress=0x50200000 size=0x00010000
  SRAM baseAddress=0x61000000 size=0x00200000
  RERAM baseAddress=0x60000000 size=0x00400000
  XIP baseAddress=0x70000000 size=0x04000000
  PL230 baseAddress=0x40011000 size=0x00001000
  MDMA baseAddress=0x40012000 size=0x00001000
  MBOX_APB baseAddress=0x40013000 size=0x00001000
  IOX baseAddress=0x5012F000 size=0x00001000
  BIO_IMEM0 baseAddress=0x50125000 size=0x00001000
  BIO_IMEM1 baseAddress=0x50126000 size=0x00001000
  BIO_IMEM2 baseAddress=0x50127000 size=0x00001000
  BIO_IMEM3 baseAddress=0x50128000 size=0x00001000
  BIO_FIFO0 baseAddress=0x50129000 size=0x00001000
  BIO_FIFO1 baseAddress=0x5012A000 size=0x00001000
  BIO_FIFO2 baseAddress=0x5012B000 size=0x00001000
  BIO_FIFO3 baseAddress=0x5012C000 size=0x00001000
  AORAM baseAddress=0x50300000 size=0x00004000
  CSR baseAddress=0xE0000000 size=0x00040000
constants:
  CONFIG_CLOCK_FREQUENCY value=800000000
  CONFIG_CPU_HAS_INTERRUPT value=None
  CONFIG_CPU_RESET_ADDR value=1610612736
  CONFIG_CPU_HAS_DCACHE value=None
  CONFIG_CPU_HAS_ICACHE value=None
  CONFIG_CPU_TYPE_VEXRISCV_AXI value=None
  CONFIG_CPU_VARIANT_STANDARD value=None
  CONFIG_CPU_HUMAN_NAME value=VexRiscvAxi4
  CONFIG_CPU_NOP value=nop
  IFSUB_EV_QFCIRQ value=32
  IFSUB_EV_MDMAIRQ value=33
  IFSUB_EV_MBOX_IRQ_AVAILABLE value=34
  IFSUB_EV_MBOX_IRQ_ABORT_INIT value=35
  IFSUB_EV_MBOX_IRQ_DONE value=36
  IFSUB_EV_MBOX_IRQ_ERROR value=37
  IFSUB_EV_AOWKUPINT value=47
  IFSUB_EV_TRNG_DONE value=48
  IFSUB_EV_AES_DONE value=49
  IFSUB_EV_PKE_DONE value=50
  IFSUB_EV_HASH_DONE value=51
  IFSUB_EV_ALU_DONE value=52
  IFSUB_EV_SDMA_ICHDONE value=53
  IFSUB_EV_SDMA_SCHDONE value=54
  IFSUB_EV_SDMA_XCHDONE value=55
  IFSUB_EV_UART0_RX value=80
  IFSUB_EV_UART0_TX value=81
  IFSUB_EV_UART0_RX_CHAR value=82
  IFSUB_EV_UART0_ERR value=83
  IFSUB_EV_UART1_RX value=84
  IFSUB_EV_UART1_TX value=85
  IFSUB_EV_UART1_RX_CHAR value=86
  IFSUB_EV_UART1_ERR value=87
  IFSUB_EV_UART2_RX value=88
  IFSUB_EV_UART2_TX value=89
  IFSUB_EV_UART2_RX_CHAR value=90
  IFSUB_EV_UART2_ERR value=91
  IFSUB_EV_UART3_RX value=92
  IFSUB_EV_UART3_TX value=93
  IFSUB_EV_UART3_RX_CHAR value=94
  IFSUB_EV_UART3_ERR value=95
  IFSUB_EV_SPIM0_RX value=96
  IFSUB_EV_SPIM0_TX value=97
  IFSUB_EV_SPIM0_CMD value=98
  IFSUB_EV_SPIM0_EOT value=99
  IFSUB_EV_SPIM1_RX value=100
  IFSUB_EV_SPIM1_TX value=101
  IFSUB_EV_SPIM1_CMD value=102
  IFSUB_EV_SPIM1_EOT value=103
  IFSUB_EV_SPIM2_RX value=104
  IFSUB_EV_SPIM2_TX value=105
  IFSUB_EV_SPIM2_CMD value=106
  IFSUB_EV_SPIM2_EOT value=107
  IFSUB_EV_SPIM3_RX value=108
  IFSUB_EV_SPIM3_TX value=109
  IFSUB_EV_SPIM3_CMD value=110
  IFSUB_EV_SPIM3_EOT value=111
  IFSUB_EV_I2C0_RX value=112
  IFSUB_EV_I2C0_TX value=113
  IFSUB_EV_I2C0_CMD value=114
  IFSUB_EV_I2C0_EOT value=115
  IFSUB_EV_I2C1_RX value=116
  IFSUB_EV_I2C1_TX value=117
  IFSUB_EV_I2C1_CMD value=118
  IFSUB_EV_I2C1_EOT value=119
  IFSUB_EV_I2C2_RX value=120
  IFSUB_EV_I2C2_TX value=121
  IFSUB_EV_I2C2_CMD value=122
  IFSUB_EV_I2C2_EOT value=123
  IFSUB_EV_I2C3_RX value=124
  IFSUB_EV_I2C3_TX value=125
  IFSUB_EV_I2C3_CMD value=126
  IFSUB_EV_I2C3_EOT value=127
  IFSUB_EV_SDIO_RX value=128
  IFSUB_EV_SDIO_TX value=129
  IFSUB_EV_SDIO_EOT value=130
  IFSUB_EV_SDIO_ERR value=131
  IFSUB_EV_I2S_RX value=132
  IFSUB_EV_I2S_TX value=133
  IFSUB_EV_CAM_RX value=136
  IFSUB_EV_ADC_RX value=137
  IFSUB_EV_FILTER_EOT value=140
  IFSUB_EV_FILTER_ACT value=141
  IFSUB_EV_SCIF_RX value=144
  IFSUB_EV_SCIF_TX value=145
  IFSUB_EV_SCIF_RX_CHAR value=146
  IFSUB_EV_SCIF_ERR value=147
  IFSUB_EV_SPIS0_RX value=148
  IFSUB_EV_SPIS0_TX value=149
  IFSUB_EV_SPIS0_EOT value=150
  IFSUB_EV_SPIS1_RX value=152
  IFSUB_EV_SPIS1_TX value=153
  IFSUB_EV_SPIS1_EOT value=154
  IFSUB_EV_PWM0_EV value=156
  IFSUB_EV_PWM1_EV value=157
  IFSUB_EV_PWM2_EV value=158
  IFSUB_EV_PWM3_EV value=159
  IFSUB_EV_IOXIRQ value=160
  IFSUB_EV_USBC value=161
  IFSUB_EV_SDDCIRQ value=162
  IFSUB_EV_PIOIRQ0 value=163
  IFSUB_EV_PIOIRQ1 value=164
  IFSUB_EV_PIOIRQ2 value=165
  IFSUB_EV_PIOIRQ3 value=166
  IFSUB_EV_I2C0_NACK value=200
  IFSUB_EV_I2C1_NACK value=201
  IFSUB_EV_I2C2_NACK value=202
  IFSUB_EV_I2C3_NACK value=203
  IFSUB_EV_I2C0_ERR value=204
  IFSUB_EV_I2C1_ERR value=205
  IFSUB_EV_I2C2_ERR value=206
  IFSUB_EV_I2C3_ERR value=207
  IFSUB_EV_CORESUBERR value=208
  IFSUB_EV_SCEERR value=209
  IFSUB_EV_IFSUBERR value=210
  IFSUB_EV_SECIRQ value=211
  IFSUB_EV_SEC0 value=240
  CONFIG_CSR_DATA_WIDTH value=32
  CONFIG_CSR_ALIGNMENT value=32
  CONFIG_BUS_STANDARD value=AXI-LITE
  CONFIG_BUS_DATA_WIDTH value=32
  CONFIG_BUS_ADDRESS_WIDTH value=32
  CONFIG_BUS_BURSTING value=0
  IRQARRAY{n}_INTERRUPT value={n} (n=0..19)
  MAILBOX_INTERRUPT value=22
  MB_CLIENT_INTERRUPT value=23
  SUSRES_INTERRUPT value=21
  TICKTIMER_INTERRUPT value=20
  TIMER0_INTERRUPT value=30
